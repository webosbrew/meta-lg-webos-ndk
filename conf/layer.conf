## conf/layer.conf
```bitbake
# ndk layer
BBPATH =. "${LAYERDIR}:"
BBFILES += "${LAYERDIR}/recipes/*/*.bb \
            ${LAYERDIR}/appends/*.bbappend"
BBFILE_COLLECTIONS += "ndklayer"
BBFILE_PATTERN_ndklayer = "^${LAYERDIR}/"
BBFILE_PATTERN_IGNORE_EMPTY_ndklayer = "1"
BBFILE_PRIORITY_ndklayer = "99"

require conf/override/disabled-pkgs.inc
```
